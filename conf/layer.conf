## conf/machine/include/amlogic-a113.inc
```bitbake
# Amlogic A113D/X SoC configuration

require conf/machine/include/amlogic-arm64.inc

SOC_FAMILY:append = ":meson-gx-boot:meson-axg:a113"

DEFAULTTUNE ?= "cortexa53"
require conf/machine/include/arm/armv8a/tune-cortexa53.inc
```

## conf/machine/include/amlogic-a311d.inc
```bitbake
# Amlogic A311D SoC configuration

require conf/machine/include/amlogic-g12b.inc

SOC_FAMILY_append = ":a311d"
```

## conf/machine/include/amlogic-default-providers.inc
```bitbake
# Default providers for (lazy) amlogic machines

# linux kernel:
PREFERRED_PROVIDER_virtual/kernel ??= "linux-nosem-stable"
PREFERRED_VERSION_linux-yocto ??= "5.10%"

# u-boot bootloader:
PREFERRED_PROVIDER_virtual/bootloader ??= "u-boot"
PREFERRED_PROVIDER_u-boot-fw-utils ??= "libubootenv"
PREFERRED_VERSION_u-boot ??= "2021.01"
MACHINE_EXTRA_RRECOMMENDS:append = ' ${@oe.utils.conditional("PREFERRED_PROVIDER_virtual/bootloader", "u-boot", "u-boot-fw-utils", "", d)}'

# Arm Trusted Firmware
PREFERRED_PROVIDER_virtual/trusted-firmware-a ??= "amlogic-prebuilt-atf"
```

## conf/machine/include/amlogic-g12.inc
```bitbake
# Amlogic G12 SoC family configuration

require conf/machine/include/amlogic-arm64.inc

SOC_FAMILY_append = ":meson-g12"
```

## conf/machine/include/amlogic-g12a.inc
```bitbake
# Amlogic G12A SoC family configuration

require conf/machine/include/amlogic-g12.inc

SOC_FAMILY:append = ":meson-g12a"

DEFAULTTUNE ?= "cortexa53"
require conf/machine/include/tune-cortexa53.inc
```

## conf/machine/include/amlogic-g12b.inc
```bitbake
# Amlogic G12B SoC family configuration

require conf/machine/include/amlogic-g12.inc

SOC_FAMILY:append = ":meson-g12b"

DEFAULTTUNE ?= "cortexa73-cortexa53"
require conf/machine/include/tune-cortexa73-cortexa53.inc
```

## conf/machine/include/amlogic-gx.inc
```bitbake
# Amlogic GX SoC family configuration

require conf/machine/include/amlogic-arm64.inc

SOC_FAMILY_append = ":meson-gx-boot:meson-gx"

DEFAULTTUNE ?= "cortexa53"
require conf/machine/include/tune-cortexa53.inc
```

## conf/machine/include/amlogic-gxl.inc
```bitbake
# Amlogic GXL SoC family configuration

require conf/machine/include/amlogic-gx.inc

SOC_FAMILY_append = ":meson-gxl"
```

## conf/machine/include/amlogic-s805x.inc
```bitbake
# Amlogic S805X SoC configuration

require conf/machine/include/amlogic-gxl.inc

SOC_FAMILY_append = ":s805x"
```

## conf/machine/include/amlogic-s905d2.inc
```bitbake
# Amlogic S905D2 SoC configuration

require conf/machine/include/amlogic-s905dx2.inc

SOC_FAMILY:append = ":s905d2"
```

## conf/machine/include/amlogic-s905d3.inc
```bitbake
# Amlogic S905D3 SoC configuration

require conf/machine/include/amlogic-s905dx3.inc

SOC_FAMILY:append = ":s905d3"
```

## conf/machine/include/amlogic-s905dx.inc
```bitbake
# Amlogic S905D/X SoC common configuration

require conf/machine/include/amlogic-gxl.inc

SOC_FAMILY:append = ":s905dx"
```

## conf/machine/include/amlogic-s905dx2.inc
```bitbake
# Amlogic S905D/X2 SoC common configuration

require conf/machine/include/amlogic-g12a.inc

SOC_FAMILY:append = ":s905dx2"
```

## conf/machine/include/amlogic-s905dx3.inc
```bitbake
# Amlogic S905D/X3 SoC common configuration

require conf/machine/include/amlogic-sm1.inc

SOC_FAMILY:append = ":s905dx3"
```

## conf/machine/include/amlogic-s905x.inc
```bitbake
# Amlogic S905X SoC configuration

require conf/machine/include/amlogic-s905dx.inc

SOC_FAMILY_append = ":s905x"
```
