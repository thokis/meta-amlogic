## conf/machine/include/amlogic-s905x2.inc
```bitbake
# Amlogic S905X2 SoC configuration

require conf/machine/include/amlogic-s905dx2.inc

SOC_FAMILY:append = ":s905x2"
```

## conf/machine/include/amlogic-sm1.inc
```bitbake
# Amlogic SM1 SoC family configuration

require conf/machine/include/amlogic-arm64.inc

SOC_FAMILY:append = ":meson-sm1"

DEFAULTTUNE ?= "cortexa55"
require conf/machine/include/arm/armv8-2a/tune-cortexa55.inc
```

## conf/machine/include/libretech-cottonwood.inc
```bitbake
PREFERRED_PROVIDER_virtual/kernel ?= "linux-yocto"
MACHINE_FEATURES:append = " alsa bluetooth screen usbgadget usbhost vfat wifi"
MACHINEOVERRIDES:append = ":libretech-cottonwood"

require conf/machine/include/amlogic-wic.inc
```
