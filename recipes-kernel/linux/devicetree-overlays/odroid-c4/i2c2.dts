/dts-v1/;
/plugin/;

/{
    compatible = "hardkernel,odroid-c4", "amlogic,sm1";

    fragment@0 {
        target = <&i2c2>;
        __overlay__ {
            status = "okay";
            pinctrl-0 = <&i2c2_sck_x_pins>, <&i2c2_sda_x_pins>;
            pinctrl-names = "default";

            rtc: rtc@68 {
                compatible = "maxim,ds3231";
                reg = <0x68>;
            };
        };
    };
};
