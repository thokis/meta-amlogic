/dts-v1/;
/plugin/;

/{
    fragment@0 {
        target = <&external_mdio>;
        __overlay__ {
            external_phy: ethernet-phy@0 {
                /* Realtek RTL8211F (0x001cc916) */
                reg = <0>;
                max-speed = <1000>;

                reset-assert-us = <10000>;
                reset-deassert-us = <80000>;
                reset-gpios = <&gpio 14 0>;

                interrupt-parent = <&gpio_intc>;
                /* MAC_INTR on GPIOZ_15 */
                interrupts = <25 8>;
            };
        };
    };
};
